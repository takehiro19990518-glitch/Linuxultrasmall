## Config.in
```kconfig
source "$BR2_EXTERNAL_P3LINUX_PATH/package/p3-desktop/Config.in"
source "$BR2_EXTERNAL_P3LINUX_PATH/package/p3-firmware/Config.in"
source "$BR2_EXTERNAL_P3LINUX_PATH/package/fonts-vlgothic/Config.in"
source "$BR2_EXTERNAL_P3LINUX_PATH/package/antiword/Config.in"
source "$BR2_EXTERNAL_P3LINUX_PATH/package/catdoc/Config.in"
source "$BR2_EXTERNAL_P3LINUX_PATH/package/sc-im/Config.in"
source "$BR2_EXTERNAL_P3LINUX_PATH/package/xbill/Config.in"
source "$BR2_EXTERNAL_P3LINUX_PATH/package/xjump/Config.in"
source "$BR2_EXTERNAL_P3LINUX_PATH/package/freedoom/Config.in"
source "$BR2_EXTERNAL_P3LINUX_PATH/package/libcroco3/Config.in"
source "$BR2_EXTERNAL_P3LINUX_PATH/package/librsvg-legacy/Config.in"
source "$BR2_EXTERNAL_P3LINUX_PATH/package/libgsf/Config.in"
source "$BR2_EXTERNAL_P3LINUX_PATH/package/wv/Config.in"
source "$BR2_EXTERNAL_P3LINUX_PATH/package/goffice/Config.in"
source "$BR2_EXTERNAL_P3LINUX_PATH/package/abiword/Config.in"
source "$BR2_EXTERNAL_P3LINUX_PATH/package/gnumeric/Config.in"
```

## configs/p3linux_defconfig
```kconfig
# ---- Target: Intel Pentium III (i686 + SSE, no SSE2) ----
BR2_x86_pentium3=y
BR2_OPTIMIZE_S=y
# X.Org modules need lazy binding with musl (see external.mk)
BR2_RELRO_PARTIAL=y
# ---- Toolchain: Buildroot internal, musl libc ----
BR2_TOOLCHAIN_BUILDROOT_MUSL=y
BR2_KERNEL_HEADERS_AS_KERNEL=y
BR2_PACKAGE_HOST_LINUX_HEADERS_CUSTOM_6_12=y
BR2_TOOLCHAIN_BUILDROOT_CXX=y
BR2_BINUTILS_VERSION_2_44_X=y
# ---- System ----
BR2_TARGET_GENERIC_HOSTNAME="p3linux"
BR2_TARGET_GENERIC_ISSUE="Welcome to P3 Linux"
BR2_ROOTFS_DEVICE_CREATION_DYNAMIC_EUDEV=y
BR2_TARGET_GENERIC_ROOT_PASSWD="p3linux"
BR2_SYSTEM_DHCP="eth0"

BR2_ROOTFS_OVERLAY="$(BR2_EXTERNAL_P3LINUX_PATH)/board/p3linux/rootfs-overlay"
BR2_ROOTFS_POST_BUILD_SCRIPT="$(BR2_EXTERNAL_P3LINUX_PATH)/board/p3linux/post-build.sh"
BR2_ROOTFS_POST_IMAGE_SCRIPT="$(BR2_EXTERNAL_P3LINUX_PATH)/board/p3linux/post-image.sh"
BR2_TARGET_GENERIC_GETTY_PORT="tty2"
# ---- Kernel: Linux 6.12 LTS ----
BR2_LINUX_KERNEL=y
BR2_LINUX_KERNEL_CUSTOM_GIT=y
BR2_LINUX_KERNEL_CUSTOM_REPO_URL="https://gitlab.com/linux-kernel/stable.git"
BR2_LINUX_KERNEL_CUSTOM_REPO_VERSION="v6.12.111"
BR2_LINUX_KERNEL_USE_ARCH_DEFAULT_CONFIG=y
BR2_LINUX_KERNEL_CONFIG_FRAGMENT_FILES="$(BR2_EXTERNAL_P3LINUX_PATH)/board/p3linux/linux.fragment $(BR2_EXTERNAL_P3LINUX_PATH)/board/p3linux/linux-drivers.fragment"
BR2_LINUX_KERNEL_BZIMAGE=y
# ---- Base userland ----
BR2_PACKAGE_BUSYBOX_CONFIG_FRAGMENT_FILES="$(BR2_EXTERNAL_P3LINUX_PATH)/board/p3linux/busybox.fragment"
BR2_PACKAGE_E2FSPROGS=y
BR2_PACKAGE_DOSFSTOOLS=y
BR2_PACKAGE_DOSFSTOOLS_MKFS_FAT=y
BR2_PACKAGE_DOSFSTOOLS_FSCK_FAT=y
# ---- X.Org ----
BR2_PACKAGE_XORG7=y
BR2_PACKAGE_LIBGCRYPT=y
BR2_PACKAGE_XSERVER_XORG_SERVER=y
BR2_PACKAGE_XSERVER_XORG_SERVER_MODULAR=y
BR2_PACKAGE_XDRIVER_XF86_INPUT_EVDEV=y
BR2_PACKAGE_XDRIVER_XF86_VIDEO_VESA=y
BR2_PACKAGE_XDRIVER_XF86_VIDEO_FBDEV=y
BR2_PACKAGE_XAPP_XKBCOMP=y
BR2_PACKAGE_XTERM=y
BR2_PACKAGE_DEJAVU=y
BR2_PACKAGE_FONTCONFIG=y
# ---- Window manager + desktop ----
BR2_PACKAGE_FLUXBOX=y
BR2_PACKAGE_FLTK=y
BR2_PACKAGE_P3_DESKTOP=y
# ---- Bootloader / images ----
BR2_TARGET_ROOTFS_CPIO=y
BR2_TARGET_ROOTFS_CPIO_GZIP=y
BR2_TARGET_ROOTFS_EXT2=y
BR2_TARGET_ROOTFS_EXT2_2=y
BR2_TARGET_ROOTFS_EXT2_SIZE="400M"
# BR2_TARGET_ROOTFS_TAR is not set
# ---- Hardware support (drivers are kernel modules, see linux-drivers.fragment) ----
BR2_PACKAGE_P3_FIRMWARE=y
BR2_PACKAGE_BUSYBOX_SHOW_OTHERS=y
BR2_PACKAGE_KMOD=y
BR2_PACKAGE_KMOD_TOOLS=y
BR2_PACKAGE_PCIUTILS=y
BR2_PACKAGE_USBUTILS=y
BR2_PACKAGE_ALSA_LIB=y
BR2_PACKAGE_ALSA_UTILS=y
BR2_PACKAGE_ALSA_UTILS_ALSACTL=y
BR2_PACKAGE_ALSA_UTILS_ALSAMIXER=y
BR2_PACKAGE_ALSA_UTILS_AMIXER=y
BR2_PACKAGE_ALSA_UTILS_APLAY=y
BR2_PACKAGE_ALSA_UTILS_SPEAKER_TEST=y
BR2_PACKAGE_WPA_SUPPLICANT=y
BR2_PACKAGE_WPA_SUPPLICANT_NL80211=y
BR2_PACKAGE_WPA_SUPPLICANT_WEXT=y
BR2_PACKAGE_WPA_SUPPLICANT_CLI=y
BR2_PACKAGE_WPA_SUPPLICANT_PASSPHRASE=y
BR2_PACKAGE_WPA_SUPPLICANT_AUTOSCAN=y
BR2_PACKAGE_IW=y
BR2_PACKAGE_WIRELESS_TOOLS=y
BR2_PACKAGE_WIRELESS_REGDB=y
BR2_PACKAGE_CIFS_UTILS=y
BR2_PACKAGE_XDRIVER_XF86_VIDEO_R128=y
BR2_PACKAGE_XDRIVER_XF86_VIDEO_MACH64=y
BR2_PACKAGE_XDRIVER_XF86_VIDEO_MGA=y
BR2_PACKAGE_XDRIVER_XF86_VIDEO_SAVAGE=y
BR2_PACKAGE_XDRIVER_XF86_VIDEO_NEOMAGIC=y
BR2_PACKAGE_XDRIVER_XF86_VIDEO_TDFX=y
BR2_PACKAGE_XDRIVER_XF86_VIDEO_SILICONMOTION=y
BR2_PACKAGE_XDRIVER_XF86_VIDEO_CIRRUS=y
# ---- Applications (phase 2a) ----
# Internet
BR2_PACKAGE_OPENSSL=y
BR2_PACKAGE_CA_CERTIFICATES=y
BR2_PACKAGE_DILLO=y
BR2_PACKAGE_LINKS=y
BR2_PACKAGE_LINKS_GRAPHICS=y
BR2_PACKAGE_LIBCURL=y
BR2_PACKAGE_LIBCURL_CURL=y
BR2_PACKAGE_WGET=y
BR2_PACKAGE_LFTP=y
BR2_PACKAGE_IRSSI=y
BR2_PACKAGE_DROPBEAR=y
BR2_PACKAGE_DROPBEAR_CLIENT=y
BR2_PACKAGE_RSYNC=y
# Documents and images
BR2_PACKAGE_MUPDF=y
BR2_PACKAGE_FEH=y
# Sound
BR2_PACKAGE_MPG123=y
BR2_PACKAGE_SOX=y
BR2_PACKAGE_FLAC=y
# Utilities
BR2_PACKAGE_VIM=y
BR2_PACKAGE_NANO=y
BR2_PACKAGE_MC=y
BR2_PACKAGE_HTOP=y
BR2_PACKAGE_TMUX=y
BR2_PACKAGE_LESS=y
BR2_PACKAGE_FILE=y
BR2_PACKAGE_NCDU=y
BR2_PACKAGE_UNZIP=y
BR2_PACKAGE_P7ZIP=y
BR2_PACKAGE_P7ZIP_7ZA=y
BR2_PACKAGE_BZIP2=y
BR2_PACKAGE_XZ=y
BR2_PACKAGE_HDPARM=y
BR2_PACKAGE_PARTED=y
BR2_PACKAGE_CDRKIT=y
BR2_PACKAGE_XAPP_XCALC=y
BR2_PACKAGE_XAPP_XCLOCK=y
# Games
BR2_PACKAGE_LBREAKOUT2=y
BR2_PACKAGE_LTRIS=y
BR2_PACKAGE_GNUCHESS=y
# Office (terminal), document viewers, Japanese font, more games
BR2_PACKAGE_SC_IM=y
BR2_PACKAGE_ANTIWORD=y
BR2_PACKAGE_CATDOC=y
BR2_PACKAGE_FONTS_VLGOTHIC=y
BR2_PACKAGE_XBILL=y
BR2_PACKAGE_XJUMP=y
BR2_PACKAGE_CHOCOLATE_DOOM=y
BR2_PACKAGE_FREEDOOM=y
# BR2_PACKAGE_SDL_FBCON is not set
```

## package/abiword/Config.in
```kconfig
config BR2_PACKAGE_ABIWORD
	bool "abiword"
	depends on BR2_PACKAGE_LIBGTK3
	select BR2_PACKAGE_BOOST
	select BR2_PACKAGE_LIBFRIBIDI
	select BR2_PACKAGE_LIBGSF
	select BR2_PACKAGE_LIBRSVG_LEGACY
	select BR2_PACKAGE_LIBXSLT
	select BR2_PACKAGE_WV
```

## package/gnumeric/Config.in
```kconfig
config BR2_PACKAGE_GNUMERIC
	bool "gnumeric"
	depends on BR2_PACKAGE_LIBGTK3
	select BR2_PACKAGE_GOFFICE
```

## package/goffice/Config.in
```kconfig
config BR2_PACKAGE_GOFFICE
	bool "goffice"
	depends on BR2_PACKAGE_LIBGTK3
	select BR2_PACKAGE_LIBGSF
	select BR2_PACKAGE_LIBRSVG_LEGACY
	select BR2_PACKAGE_LIBXSLT
```

## package/libcroco3/Config.in
```kconfig
config BR2_PACKAGE_LIBCROCO3
	bool "libcroco3"
	select BR2_PACKAGE_LIBGLIB2
	select BR2_PACKAGE_LIBXML2
```

## package/libgsf/Config.in
```kconfig
config BR2_PACKAGE_LIBGSF
	bool "libgsf"
	select BR2_PACKAGE_LIBGLIB2
	select BR2_PACKAGE_LIBXML2
	select BR2_PACKAGE_ZLIB
```

## package/librsvg-legacy/Config.in
```kconfig
config BR2_PACKAGE_LIBRSVG_LEGACY
	bool "librsvg-legacy"
	help
	  librsvg 2.40 (the last version written in C, no Rust needed)
	select BR2_PACKAGE_CAIRO
	select BR2_PACKAGE_CAIRO_PNG
	select BR2_PACKAGE_GDK_PIXBUF
	select BR2_PACKAGE_LIBCROCO3
	select BR2_PACKAGE_LIBGLIB2
	select BR2_PACKAGE_LIBXML2
	select BR2_PACKAGE_PANGO
```

## package/p3-desktop/Config.in
```kconfig
config BR2_PACKAGE_P3_DESKTOP
	bool "p3-desktop"
	depends on BR2_PACKAGE_FLTK
	help
	  P3 Linux desktop: start menu, file manager, text editor,
	  system information and shutdown dialog (FLTK).
```

## package/p3-firmware/Config.in
```kconfig
config BR2_PACKAGE_P3_FIRMWARE
	bool "p3-firmware"
	help
	  Firmware for P3-era devices: Radeon R100-R500, Ralink and
	  Atheros USB/PCI WLAN, Marvell Libertas, Realtek/Intel/
	  Broadcom/3Com NICs (subset of linux-firmware).
```

## package/sc-im/Config.in
```kconfig
config BR2_PACKAGE_SC_IM
	bool "sc-im"
	select BR2_PACKAGE_NCURSES
	select BR2_PACKAGE_NCURSES_WCHAR
```

## package/wv/Config.in
```kconfig
config BR2_PACKAGE_WV
	bool "wv"
	select BR2_PACKAGE_LIBGSF
	select BR2_PACKAGE_LIBPNG
```

## package/xbill/Config.in
```kconfig
config BR2_PACKAGE_XBILL
	bool "xbill"
	depends on BR2_PACKAGE_XORG7
	select BR2_PACKAGE_XLIB_LIBXAW
	select BR2_PACKAGE_XLIB_LIBXPM
```

## package/xjump/Config.in
```kconfig
config BR2_PACKAGE_XJUMP
	bool "xjump"
	depends on BR2_PACKAGE_XORG7
	select BR2_PACKAGE_XLIB_LIBXAW
	select BR2_PACKAGE_XLIB_LIBXPM
```
